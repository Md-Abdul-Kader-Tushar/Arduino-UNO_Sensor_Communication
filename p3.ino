

#include "talkie.h"
#include <LiquidCrystal.h>


LiquidCrystal lcd(12, 11, 5, 4, 8, 2);
Talkie voice;
const int8_t spCLEAR[] PROGMEM = {0x0C,0xC8,0xA3,0x39,0x00,0xC5,0x96,0x3B,0xA0,0x73,0x4F,0x03,0x4C,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0xFA,0xFF};
const int8_t spSERVICE[] PROGMEM = {0x0C,0xF8,0x29,0x45,0x01,0xBF,0x95,0x5A,0x20,0x00,0xBF,0xA5,0x3A,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0xFF,0x07};
const int8_t spFAST[]          PROGMEM = {0x08,0x68,0xD6,0x55,0x02,0x0A,0x18,0x22,0x5D,0x02,0x1A,0x58,0x45,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0xF9,0x7F};
//const int8_t spPAPA[] PROGMEM = {0x0A,0x28,0x56,0xB9,0xA5,0x45,0x55,0x84,0x49,0xCC,0x93,0x66,0xD7,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0xFF,0x03};
const int8_t spCOME[]              PROGMEM ={0x0E,0x88,0xCD,0xD4,0x01,0xCE,0xB9,0x38,0x20,0xBA,0x54,0x05,0xC4,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0xFD,0x03};
//const int8_t spGOODBYE[]           PROGMEM ={0xA9,0x49,0xE1,0x54,0x91,0x2D,0xAF,0x22,0x07,0x55,0x29,0x69,0x7B,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0x00,0x00};
const int8_t spEMERGENCY[] PROGMEM = {0xA3,0x5B,0xCE,0x18,0x23,0x9F,0xAC,0x76,0x79,0x13,0x88,0x7C,0xB2,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0xFF,0x1F};
void setup() {
 
  
  lcd.begin(16, 2);
  Serial.begin(9600);
  pinMode(13,OUTPUT);
  pinMode(3,OUTPUT);
 
  
}

void loop() {
  
  //int i,j;

  //for(i=0;i<5;i++)
//{  
 

int x = analogRead(A1);
int y = analogRead(A2);
int z = analogRead(A0);

Serial.println("1st:    ");
Serial.println(x);
Serial.println("2nd:   ");
Serial.println(y);
Serial.println("\n");
Serial.println(z);


lcd.setCursor(0, 1);

  if( 35 > x && 20 >y && 300 < z )
  {
    
  lcd.print("Normal");
  digitalWrite(13,LOW);
  
  }
  else if(x >35 && 20 > y && 300 < z)
{
  lcd.print("Calling Service");
  voice.say(spSERVICE);
  delay(1000);
  lcd.clear();
  digitalWrite(13,LOW);
}
  else if(x <35 && 20 < y && 300 < z)
{
  lcd.print("Come Fast");
  
  voice.say(spCOME);
  voice.say(spFAST);
  delay(1000);
  lcd.clear();
  
}

  
  else if ( 35 < x && 20 < y && 300 < z)
  {
    //tone(7,800,10);
    //delay(100);
 
    //tone(7,800,10);
    //delay(100);
    //tone(7,800,10);
  
  digitalWrite(13,HIGH);
  
 
 
  lcd.print("EMERGENCY");
    voice.say(spEMERGENCY);
    //tone(3,770,100);
    //delay(150);
    //tone(3,960,100);
  
 delay(1000);
  lcd.clear();
  
  }
  else if (35 > x && 20 >y && 300 > z)
  {
    lcd.print("Clear");
    voice.say(spCLEAR);
    delay(1000);
    lcd.clear();
    digitalWrite(13,LOW);
  }
  
 delay(1000);
  
}
